#define HAS_MOUSE_KEYS
#define HAS_MOUSE_TP

#ifdef HAS_MOUSE_KEYS
  #include <dt-bindings/zmk/mouse.h>
  #include <behaviors/mouse_keys.dtsi>
#endif  // HAS_MOUSE_KEYS

#ifdef HAS_MOUSE_TP
  #include "include/mouse_tp.dtsi"
#endif  // HAS_MOUSE_TP

/ {
    chosen {
        zmk,matrix_transform = &five_column_transform;
    };
};

// https://github.com/TuanAnhNguyen69/zmk-config
// A Keyboard Keymap has 2 responsibilities in this layout system:
//
// 1. Include the correct key positions definition from the `key-labels`
//    directory, which helps making combos work across all keyboards.
// 2. Define a macro function called `LAYER_ADAPTER` that receives 72 arguments
//    (one per key in the layout), and replace by the keyboard's physical layout
//    shape.
//
// After this is done, you need to import the standard layout file, so it can
// create the keymap using the macro function you previously created.

#include "helpers/key-labels/3x5+3.dtsi"

// Define the layer adapter function for the Charybdis
#define LAYER_ADAPTER(                                                    \
    LN5, LN4, LN3, LN2, LN1, LN0,           RN0, RN1, RN2, RN3, RN4, RN5, \
    LT5, LT4, LT3, LT2, LT1, LT0,           RT0, RT1, RT2, RT3, RT4, RT5, \
    LM5, LM4, LM3, LM2, LM1, LM0,           RM0, RM1, RM2, RM3, RM4, RM5, \
    LB5, LB4, LB3, LB2, LB1, LB0,           RB0, RB1, RB2, RB3, RB4, RB5, \
    LH5, LH4, LH3, LH2, LH1, LH0,           RH0, RH1, RH2, RH3, RH4, RH5, \
    LHB, LHA, LH9, LH8, LH7, LH6,           RH6, RH7, RH8, RH9, RHA, RHB  \
)                                                                         \
         LT4  LT3  LT2  LT1  LT0            RT0  RT1  RT2  RT3  RT4       \
         LM4  LM3  LM2  LM1  LM0            RM0  RM1  RM2  RM3  RM4       \
         LB4  LB3  LB2  LB1  LB0            RB0  RB1  RB2  RB3  RB4       \
                   LH2  LH1  LH0            RH0  RH1  RH2                 \

#include "layout/standard-layout.dtsi"
